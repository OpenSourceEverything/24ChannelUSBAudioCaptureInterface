## firmware/meta-ose-audio/conf/layer.conf
```bitbake
BBPATH .= ":${LAYERDIR}"
BBFILES += "${LAYERDIR}/recipes-*/*/*.bb ${LAYERDIR}/recipes-*/*/*.bbappend"
BBFILE_COLLECTIONS += "oseaudio"
BBFILE_PATTERN_oseaudio = "^${LAYERDIR}/"
BBFILE_PRIORITY_oseaudio = "6"
LAYERSERIES_COMPAT_oseaudio = "scarthgap"
LAYERDEPENDS_oseaudio = "core"
```
